//---------------------------------------------------
//Some Code blocks are Deactivated.
//Not removed, because I may use them later if needed;
//---------------------------------------------------


#include <Wire.h>
#include <Adafruit_GFX.h>
#include <Adafruit_SSD1306.h>
#include <DHT.h>
#include <LiquidCrystal_I2C.h>
#include "credentials.h"

#define SCREEN_WIDTH 128
#define SCREEN_HEIGHT 64
#define OLED_RESET  -1
unsigned long artcounter =0;
int dispcounter = 0;

int lrdpin = 34;
int lut = 0;

float temp = 0;
float humid = 0;

bool lutstatus = true;

#define DHTPIN 4
#define DHTTYPE DHT22

Adafruit_SSD1306 display(SCREEN_WIDTH,SCREEN_HEIGHT,&Wire,OLED_RESET);
LiquidCrystal_I2C lcd(0x27, 16, 2);

DHT dht(DHTPIN,DHTTYPE);

extern const unsigned char art1[] PROGMEM;
extern const unsigned char art2[] PROGMEM;
extern const unsigned char art3[] PROGMEM;

extern const unsigned char* const bitmapArray[] PROGMEM; //Art Index array

unsigned long previous = 0;
const long interval = 2000;

/* OLED drift (antiburn-in) variables
int offsetY =0;
int offsetX =0;
unsigned long glide =0;
*/

unsigned long arttimer =0;
int artint = 0;

//PROTOTYPE FUNCTIONS;

void art(unsigned const char* nextArt);
void tstat(); //Prints physical status to the Displays;
void wstat(); //Prints wifi status to the displays;
void ifnan();
void antiburnin(); //Register if you are using OLED;
void lutstat();


///;;;;;;SETUP;;;;;;;;;

void setup(){
  Serial.begin(115200);
  Serial.println(F("Initializing"));

  dht.begin(); //Starting up the DHT22;

	display.begin(SSD1306_SWITCHCAPVCC, 0x3C);

	pinMode(lrdpin, INPUT);
	analogSetAttenuation(ADC_11db);

	/*
  if(!display.begin(SSD1306_SWITCHCAPVCC, 0x3C)){
    Serial.println(F("Allocation Failed"));
    for(;;);
  }
	*/

	lcd.init();
	lcd.backlight();
	lcd.clear();
	lcd.home();
	lcd.print("Environment");
	lcd.setCursor(0, 1);
	lcd.print("Loading...");

  display.clearDisplay();
  display.setTextSize(1);
  display.setTextColor(SSD1306_WHITE);
  display.setCursor(0,10);
  display.println(F("Initializing"));
  display.display();
  display.clearDisplay();
  display.drawBitmap(0, 0, art3, 128, 64, WHITE);
  display.display();
  delay(5000);
}


///SETUP ENDS;


void loop(){

  unsigned long current = millis();

  if(current - previous >= interval){     //2 Second, Non Blocking Function;

    previous = current;  
    temp = dht.readTemperature();
    humid = dht.readHumidity();
		
		if (isnan(humid) || isnan(temp)) {
    ifnan();
		}
		
		switch(dispcounter){
			case 0:
				tstat();
				break;

			case 1:
				wstat();
				break;

			case 2:
				lutstat();	
				break;

		}

		lut = analogRead(lrdpin);

		dispcounter = ((dispcounter + 1) % 3);

		if(millis()-artcounter>10000){ 
			artcounter = millis();
			display.ssd1306_command(SSD1306_DISPLAYOFF);
		}
		
		antiburnin(); //OLED Anti Burn-In Strategy;
		
		if(millis()-arttimer > 21000){
			arttimer = millis();
			unsigned const char* arttemp = bitmapArray[artint];
			art(arttemp);
			artint++;
			if(artint == 3){
				artint=0;
			}
		}
		if(lut < 600 && lutstatus == true){
			lutstatus = false;
			lcd.noBacklight();
		}
		if(lut > 1400 && lutstatus == false){
			lutstatus = true;
			lcd.backlight();
		}
  }
}


///;;;;;;;;LOOP FUNCTION ENDS;;;;;;;;


///DECLARED FUNCTIONS;;;;;;;;

void lutstat(){
	lcd.clear();
	lcd.print(F("Room Light Value"));
	lcd.setCursor(0,1);
	lcd.print(F("= "));
	lcd.print(lut);
	Serial.println("LUT:");
	Serial.println(lut);
}

void tstat(){
		/*OLED
    display.clearDisplay();
    display.setTextSize(1);
    display.setCursor(offsetX , 0+ offsetY);
    display.print(F("Environment"));

    display.setCursor(offsetX , 23 + offsetY);
    display.setTextSize(1);
    display.print(F("Temp: "));
    display.print(temp,1);
    display.print((char)247);
    display.print(F("C"));

    display.setCursor(offsetX , 48 + offsetY);
    display.setTextSize(1);
    display.print(F("Humidity: "));
    display.print(humid,1);
    display.print(F("%"));

    display.display();
		*/

		//LCD
		lcd.clear();
		lcd.home();
    lcd.print(F("Temp: "));
    lcd.print(temp,1);
    lcd.print((char)223);
    lcd.print(F("C"));

    lcd.setCursor(0,1);
    lcd.print(F("Humid: "));
    lcd.print(humid, 1);
    lcd.print(F("%"));

		//SERIAL
    Serial.println(F("Temperature: "));
    Serial.println(temp);
    Serial.println(F("Humidity: "));
    Serial.println(humid);
    Serial.println();
}

void wstat(){
	lcd.clear();
	lcd.home();
	lcd.print(F("Wifi Status:"));
	lcd.setCursor(0, 1);
	lcd.print(F("Not Connected!"));
}

void art(unsigned const char* nextArt){
	display.ssd1306_command(SSD1306_DISPLAYON);
	display.clearDisplay();
  display.drawBitmap(0, 0, nextArt, 128, 64, WHITE);
  display.display();
}

void ifnan(){
	if (isnan(humid) || isnan(temp)) {

			lcd.clear();
			lcd.home();
			lcd.print("Sensor");
			lcd.setCursor(0, 1);
			lcd.print("ERROR");

      display.clearDisplay();
      display.setTextSize(2);
      display.setTextColor(SSD1306_WHITE);
      display.setCursor(0,20);
      display.println(F("Sensor"));
      display.println(F("ERROR"));
      display.display();

      Serial.println(F("Error"));
     
      return;
    }
}

void antiburnin(){
	/* OLED ANTI BURN IN
		if(millis()-glide > 15000){ 
			glide = millis();
			offsetY++;
			offsetX++;
			if(offsetY == 8){
				offsetY = 0;
			}
			if(offsetX == 38){
				offsetX=0;
			}
		}
		*/
}


///THE art pointer array

const unsigned char* const bitmapArray[] PROGMEM = { art1, art2, art3 };

//;;;;;;;;;;;;;;;;;;ART BITMAPS;;;;;;;;;;;;;;;;;;;;;;;;;

const unsigned char art1 [] PROGMEM = {
	0xff, 0xff, 0xff, 0x00, 0x10, 0xfc, 0x16, 0x48, 0x80, 0x00, 0x21, 0x8c, 0x10, 0x3f, 0xff, 0xff, 
	0xff, 0xff, 0xfe, 0x00, 0x20, 0xe8, 0x3c, 0x10, 0x04, 0x08, 0x20, 0x86, 0x18, 0x3f, 0xff, 0xff, 
	0xff, 0xff, 0xfc, 0x00, 0x40, 0xf8, 0x38, 0x21, 0x09, 0x00, 0x00, 0xc6, 0x08, 0x1f, 0xff, 0xff, 
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	0xff, 0xff, 0xff, 0xcf, 0x6d, 0xb6, 0xd7, 0x0f, 0xe7, 0xef, 0xd6, 0xff, 0xff, 0xff, 0xff, 0xff
};
const unsigned char art2 [] PROGMEM = {
	0xff, 0xff, 0xf0, 0x00, 0x00, 0x00, 0x00, 0x00, 0x00, 0x00, 0x00, 0x01, 0xbf, 0xff, 0xff, 0xff, 
	0xff, 0xff, 0xa0, 0x00, 0x00, 0x00, 0x00, 0x00, 0x00, 0x00, 0x00, 0x00, 0xdf, 0xff, 0xff, 0xff, 
	0xff, 0xff, 0xc0, 0x00, 0x00, 0x00, 0x00, 0x00, 0x00, 0x00, 0x00, 0x1a, 0x6f, 0xff, 0xff, 0xff, 
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	0xc8, 0x00, 0x00, 0x00, 0x00, 0x01, 0x12, 0x48, 0xc0, 0x00, 0x03, 0x87, 0x00, 0x36, 0xff, 0xff
};
const unsigned char art3 [] PROGMEM = {
	0x00, 0x00, 0x00, 0x00, 0x00, 0x00, 0x00, 0x00, 0x00, 0x00, 0x00, 0x00, 0x00, 0x00, 0x00, 0x00, 
	0x00, 0x00, 0x00, 0x00, 0x00, 0x00, 0x00, 0x00, 0x00, 0x00, 0x00, 0x00, 0x00, 0x00, 0x00, 0x00, 
	0x00, 0x00, 0x00, 0x00, 0x00, 0x00, 0x00, 0x00, 0x10, 0x00, 0x00, 0x00, 0x00, 0x00, 0x00, 0x00, 
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	0x00, 0x00, 0x28, 0x07, 0xfb, 0xfb, 0x13, 0x64, 0x00, 0x1c, 0x07, 0x6f, 0x67, 0x3c, 0xc5, 0x02
};
